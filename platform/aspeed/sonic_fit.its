## platform/aspeed/sonic_fit.its
```
/dts-v1/;

/*
 * FIT Image Configuration for AST2700 SONiC - Multi-DTB Support
 *
 * This FIT image contains multiple DTBs for different hardware variants:
 * - ast2700-evb: Aspeed AST2700 EVB reference platform
 * - nh-ast2700-r0: NextHop AST2700 platform
 *
 * U-Boot selects the appropriate DTB configuration using the 'bootconf' variable
 * which is set based on hardware detection at boot time.
 *
 * Load addresses are chosen based on AST2700 memory map:
 * - RAM: 0x400000000 - 0x47e000000 (2016 MB)
 * - Reserved regions: 0x41b800000-0x423ffffff, 0x42c000000-0x431bfffff
 *
 * Safe load addresses (avoiding reserved regions):
 * - Kernel:   0x403000000 (U-Boot default loadaddr, ~10 MB)
 * - Ramdisk:  0x440000000 (after reserved regions, 192 MB allocated)
 *             Production initramfs: 37.4 MB compressed, 160 MB uncompressed
 *             IMPORTANT: Kernel decompresses initramfs IN PLACE!
 * - FDT:      0x44C000000 (after ramdisk: 0x440000000 + 192 MB)
 *
 * Memory Layout:
 *   0x403000000 ──> Kernel (10 MB)
 *   0x440000000 ──> Ramdisk (192 MB allocated for decompression)
 *                   Compressed: 37.4 MB (zstd)
 *                   Uncompressed: 160 MB (in-place decompression)
 *   0x44C000000 ──> DTB (50 KB)
 *
 * Two-cell address format: <0xHIGH 0xLOW>
 * Example: 0x44C000000 = <0x4 0x4C000000>
 *
 * See platform/aspeed/AST2700-MEMORY-MAP.md for details.
 */

/ {
	description = "Kernel fitImage for SONiC AST2700 with Multi-DTB Support";
	#address-cells = <2>;

	images {
		kernel-1 {
			description = "Linux kernel";
			data = /incbin/("__KERNEL_PATH__");
			type = "kernel";
			arch = "arm64";
			os = "linux";
			compression = "none";
			load = <0x4 0x03000000>;
			entry = <0x4 0x03000000>;
			hash-1 {
				algo = "sha256";
			};
		};
		fdt-ast2700-evb {
			description = "Flattened Device Tree blob for Aspeed AST2700 EVB";
			data = /incbin/("__DTB_PATH_ASPEED__/ast2700-evb.dtb");
			type = "flat_dt";
			arch = "arm64";
			compression = "none";
			load = <0x4 0x4C000000>;
			hash-1 {
				algo = "sha256";
			};
		};
		fdt-nh-ast2700-r0 {
			description = "Flattened Device Tree blob for NextHop AST2700";
			data = /incbin/("__DTB_PATH_ASPEED__/nh-ast2700-r0.dtb");
			type = "flat_dt";
			arch = "arm64";
			compression = "none";
			load = <0x4 0x4C000000>;
			hash-1 {
				algo = "sha256";
			};
		};
		ramdisk-1 {
			description = "Initramfs";
			data = /incbin/("__INITRD_PATH__");
			type = "ramdisk";
			arch = "arm64";
			os = "linux";
			compression = "none";
			load = <0x4 0x40000000>;
			hash-1 {
				algo = "sha256";
			};
		};
	};

	configurations {
		default = "conf-ast2700-evb";
		conf-ast2700-evb {
			description = "SONiC for Aspeed AST2700 EVB";
			kernel = "kernel-1";
			fdt = "fdt-ast2700-evb";
			ramdisk = "ramdisk-1";
			hash-1 {
				algo = "sha256";
			};
		};
		conf-nh-ast2700-r0 {
			description = "SONiC for NextHop AST2700";
			kernel = "kernel-1";
			fdt = "fdt-nh-ast2700-r0";
			ramdisk = "ramdisk-1";
			hash-1 {
				algo = "sha256";
			};
		};
	};
};
```

## platform/centec-arm64/sonic_fit.its
```
/*
 *Copyright 2018 CENTEC
 *
 */

/dts-v1/;

/ {
	description = "arm64 kernel, initramfs and FDT blob";	
	#address-cells = <1>;
    
	images {
		kernel_ctc {
			description = "ARM64 Kernel";			
			data = /incbin/("./vmlinuz-6.12.41+deb13-sonic-arm64");
			type = "kernel";			
			arch = "arm64";			
			os = "linux";			
			compression = "none";			
			load = <0x80080000>;			
			entry = <0x80080000>;			
			hash {				
				algo = "crc32";			
			};
		};
		initramfs {
			description = "initramfs";
			data = /incbin/("./initrd.img-6.12.41+deb13-sonic-arm64");
			type = "ramdisk";
			arch = "arm64";
			os = "linux";
			compression = "gzip";
			load = <0x85000000>;
			entry = <0x85000000>;
			hash {				
				algo = "crc32";			
			};
		};
		ctc_fdt {
			description = "dtb for tm_ctc5236";			
			data = /incbin/("./e530-ctc5236.dtb");			
			type = "flat_dt";
			arch = "arm64";			
			os = "linux";			
			compression = "none";			
			load = <0x88000000>;			
			hash {				
				algo = "crc32";			
			};
		};
                ctc_fdtw6010 {
                        description = "dtb for m2-w6010-48gt4x-r0";
                        data = /incbin/("./m2-w6010-48gt4x-r0.dtb");
                        type = "flat_dt";
                        arch = "arm64";
                        os = "linux";
                        compression = "none";
                        load = <0x88000000>;
                        hash {
                                algo = "crc32";
                        };
                };
	};
	configurations {
		default = "arm64-centec_e530_24x2c-r0";
					
		arm64-centec_e530_24x2c-r0 {
			description = "config for arm64-centec_e530_24x2c-r0";
			kernel = "kernel_ctc";
			ramdisk = "initramfs";
			fdt = "ctc_fdt";
			};

		arm64-centec_e530_24x2q-r0 {
			description = "config for arm64-centec_e530_24x2q-r0";
			kernel = "kernel_ctc";
			ramdisk = "initramfs";
			fdt = "ctc_fdt";
			};

		arm64-centec_e530_48s4x-r0 {
			description = "config for arm64-centec_e530_48s4x-r0";
			kernel = "kernel_ctc";
			ramdisk = "initramfs";
			fdt = "ctc_fdt";
			};

		arm64-centec_e530_48t4x_p-r0 {
			description = "config for arm64-centec_e530_48t4x_p-r0";
			kernel = "kernel_ctc";
			ramdisk = "initramfs";
			fdt = "ctc_fdt";
			};

		arm64-fs_s5800_48t4s-r0 {
			description = "config for arm64-fs_s5800_48t4s-r0";
			kernel = "kernel_ctc";
			ramdisk = "initramfs";
			fdt = "ctc_fdt";
			};
                arm64-micas_m2-w6010-48gt4x-fa-r0 {
                        description = "config for micas_m2-w6010-48gt4x-fa";
                        kernel = "kernel_ctc";
                        ramdisk = "initramfs";
                        fdt = "ctc_fdtw6010";
                        };
                arm64-micas_m2-w6010-48gt4x-ra-r0 {
                        description = "config for micas_m2-w6010-48gt4x-ra";
                        kernel = "kernel_ctc";
                        ramdisk = "initramfs";
                        fdt = "ctc_fdtw6010";
                        };
	};
};
```

## platform/marvell-arm64/sonic_fit.its
```
/dts-v1/;
  
/ {
    description = "U-Boot fitImage for SONIC Marvell Arm64";
    #address-cells = <1>;
  
    images {
        kernel_ac5x {
            description = "Linux Kernel for AC5x";
            data = /incbin/("/boot/vmlinuz-6.1.0-11-2-arm64");
            type = "kernel";
            arch = "arm64";
            os = "linux";
            compression = "none";
            load = <0x2 0x2080000>;
            entry = <0x2 0x2080000>;
            hash@1 {
                algo = "sha1";
            };
        };
        fdt_ac5x {
            description = "Flattened Device Tree blob for AC5x";
            data = /incbin/("/usr/lib/linux-image-6.1.0-11-2-arm64/marvell/ac5-98dx35xx-rd.dtb");
            type = "flat_dt";
            arch = "arm64";
            compression = "none";
            load = <0x2 0x1000000>;
            hash@1 {
                algo = "sha1";
            };
        };
        fdt_7215_a1 {
            description = "Flattened Device Tree blob for 7215_IXS_A1";
            data = /incbin/("/usr/lib/linux-image-6.1.0-11-2-arm64/marvell/7215-ixs-a1.dtb");
            type = "flat_dt";
            arch = "arm64";
            compression = "none";
            load = <0x2 0x1000000>;
            hash@1 {
                algo = "sha1";
            };
        };
        ramdisk_ac5x {
            description = "ramdisk for AC5x";
            data = /incbin/("/boot/initrd.img-6.1.0-11-2-arm64");
            type = "ramdisk";
            arch = "arm64";
            os = "linux";
            compression = "gzip";
            load = <0x2 0x6000000>;
            entry = <0x2 0x6000000>;
            hash@1 {
                algo = "sha1";
            };
        };
        kernel_1 {
            description = "Linux Kernel";
            data = /incbin/("/boot/vmlinuz-6.1.0-11-2-arm64");
            type = "kernel";
            arch = "arm64";
            os = "linux";
            compression = "none";
            load = <0x2000000>;
            entry = <0x2000000>;
            hash@1 {
                algo = "sha1";
            };
        };
        ramdisk_1 {
            description = "ramdisk";
            data = /incbin/("/boot/initrd.img-6.1.0-11-2-arm64");
            type = "ramdisk";
            arch = "arm64";
            os = "linux";
            compression = "gzip";
            load = <0x6000000>;
            entry = <0x6000000>;
            hash@1 {
                algo = "sha1";
            };
        };
        fdt_cn9131 {
            description = "Flattened Device Tree blob";
            data = /incbin/("/boot/cn9131-db-comexpress.dtb");
            type = "flat_dt";
            arch = "arm64";
            compression = "none";
            load = <0x1000000>;
            entry = <0x1000000>;
            hash@1 {
                algo = "sha1";
            };
        };
    };
    configurations {
        default = "conf_ac5x";
        conf_ac5x {
            description = "Boot Linux kernel with FDT blob + ramdisk for RD_AC5x";
            kernel = "kernel_ac5x";
            fdt = "fdt_ac5x";
            ramdisk = "ramdisk_ac5x";
            hash@1 {
                algo = "sha1";
            };
        };
        conf_7215_a1 {
            description = "Boot Linux kernel with FDT blob + ramdisk for 7125_IXS_A1";
            kernel = "kernel_ac5x";
            fdt = "fdt_7215_a1";
            ramdisk = "ramdisk_ac5x";
            hash@1 {
                algo = "sha1";
            };
        };
        conf_cn9131 {
            description = "Boot Linux kernel with FDT blob + ramdisk for CN9131";
            kernel = "kernel_1";
            fdt = "fdt_cn9131";
            ramdisk = "ramdisk_1";
            hash@1 {
                algo = "sha1";
            };
        };
   };
};
```
